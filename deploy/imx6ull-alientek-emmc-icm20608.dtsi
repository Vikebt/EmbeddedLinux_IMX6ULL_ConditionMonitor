/* Replace the existing alientek,icm20608 child of ECSPI3 with this node. */
&ecspi3 {
	status = "okay";

	icm20608@0 {
		compatible = "invensense,icm20608";
		reg = <0>;
		spi-max-frequency = <8000000>;
	};
};

